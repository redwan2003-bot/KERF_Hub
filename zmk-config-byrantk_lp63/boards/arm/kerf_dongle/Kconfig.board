## zmk-config-byrantk_lp63/boards/arm/kerf_dongle/Kconfig.board
```kconfig
config BOARD_KERF_DONGLE
	bool "kerf_dongle nRF52833 Dongle"
	depends on SOC_NRF52833_QDAA
```

## zmk-config-byrantk_lp63/boards/arm/kerf_dongle/kerf_dongle_defconfig
```kconfig
CONFIG_SOC_SERIES_NRF52X=y
CONFIG_SOC_NRF52833_QDAA=y
CONFIG_BOARD_KERF_DONGLE=y

CONFIG_SYS_CLOCK_HW_CYCLES_PER_SEC=32768
CONFIG_CLOCK_CONTROL_NRF_K32SRC_XTAL=y
CONFIG_CLOCK_CONTROL_NRF_K32SRC_20PPM=y

CONFIG_GPIO=y
CONFIG_USB_DEVICE_STACK=y
CONFIG_FLASH=y
CONFIG_FLASH_PAGE_LAYOUT=y
CONFIG_FLASH_MAP=y
CONFIG_NVS=y
CONFIG_SETTINGS_NVS=y
CONFIG_SETTINGS=y
```

## zmk-config-byrantk_lp63/boards/shields/byrantk_lp63_dongle/Kconfig.defconfig
```kconfig
if SHIELD_BYRANTK_LP63_DONGLE

config ZMK_KEYBOARD_NAME
	default "kerf_keeb Dongle"

config ZMK_SPLIT
	default y

config ZMK_SPLIT_ROLE_CENTRAL
	default y

config ZMK_STUDIO
	default y

config ZMK_STUDIO_LOCKING
	default y

endif
```

## zmk-config-byrantk_lp63/boards/shields/byrantk_lp63_dongle/Kconfig.shield
```kconfig
config SHIELD_BYRANTK_LP63_DONGLE
	def_bool $(shields_list_contains,byrantk_lp63_dongle)
```

## zmk-config-byrantk_lp63/config/west.yml
```yaml
manifest:
  remotes:
    - name: zmkfirmware
      url-base: https://github.com/zmkfirmware
  projects:
    - name: zmk
      remote: zmkfirmware
      revision: 753d8b467125fe860eec05ee71cb7ebefa08fba6
      import: app/nano.yml
    - name: zmk-kerf
      path: modules/zmk-kerf
  self:
    path: config
```

## zmk-config-byrantk_lp63/dts/bindings/zmk,behavior-batled.yaml
```yaml
description: Battery indicator behavior driving LED9
compatible: "zmk,behavior-batled"

include: [base.yaml]
```

## zmk-config-esb/Kconfig
```kconfig
menu "Kerf Firmware Features"

config KERF_LED_SPLIT
	bool "Kerf LED Strip Split Driver"
	default y
	help
	  Splits physical 9-pixel LED strip into 8 underglow pixels and 1 battery pixel.

config KERF_BATLED
	bool "Kerf Battery LED Indicator"
	default y
	help
	  Drives pixel 9 for battery status indication.

config KERF_BATLED_TAP_MS
	int "BatLED tap show duration in milliseconds"
	default 1000

config KERF_BATLED_MAX_HOLD_MS
	int "BatLED max hold duration in milliseconds"
	default 10000

config KERF_BATLED_LOW_REPEAT_MIN
	int "BatLED low battery warning repeat interval (minutes)"
	default 5

config KERF_DONGLE_STATUS_LED
	bool "Kerf Dongle RGB Status LED"
	default y
	depends on BOARD_KERF_DONGLE
	help
	  Active-low RGB status LED driver for kerf_dongle.

endmenu
```

## zmk-config-esb/boards/shields/byrantk_lp63/Kconfig.defconfig
```kconfig
if SHIELD_BYRANTK_LP63

config ZMK_KEYBOARD_NAME
	default "kerf_keeb LP63"

config ZMK_STUDIO
	default y

config ZMK_STUDIO_LOCKING
	default y

endif
```

## zmk-config-esb/boards/shields/byrantk_lp63_esb_dongle/Kconfig.defconfig
```kconfig
if SHIELD_BYRANTK_LP63_ESB_DONGLE

config ZMK_KEYBOARD_NAME
	default "kerf_keeb ESB Dongle"

config ZMK_SPLIT
	default y

config ZMK_SPLIT_ROLE_CENTRAL
	default y

config ZMK_SPLIT_BLE
	default n

config ZMK_SPLIT_ESB
	default y

config ZMK_STUDIO
	default y

config ZMK_STUDIO_LOCKING
	default y

endif
```

## zmk-config-esb/boards/shields/byrantk_lp63_esb_dongle/Kconfig.shield
```kconfig
config SHIELD_BYRANTK_LP63_ESB_DONGLE
	def_bool $(shields_list_contains,byrantk_lp63_esb_dongle)
```

## zmk-config-esb/config/west.yml
```yaml
manifest:
  remotes:
    - name: zmkfirmware
      url-base: https://github.com/zmkfirmware
    - name: damex
      url-base: https://github.com/damex
  projects:
    - name: zmk
      remote: zmkfirmware
      revision: 753d8b467125fe860eec05ee71cb7ebefa08fba6
      import: app/nano.yml
    - name: zmk-feature-split-esb
      remote: damex
      revision: v0.8.14
    - name: zmk-kerf
      path: modules/zmk-kerf
  self:
    path: config
```

## zmk-config-esb/dts/bindings/kerf,led-strip-split.yaml
```yaml
description: Split LED strip wrapper exposing a subset of pixels to underglow and reserving the remainder
compatible: "kerf,led-strip-split"

include: [base.yaml]

properties:
  chain-length:
    type: int
    required: true
    description: Total number of pixels in the physical chain (e.g. 9)
  underglow-pixels:
    type: int
    required: true
    description: Number of pixels exposed to underglow (e.g. 8)
  raw-led-strip:
    type: phandle
    required: true
    description: Underlying physical LED strip phandle (WS2812 over SPI)
```

## zmk-config-esb/dts/bindings/zmk,behavior-rgb-esb.yaml
```yaml
description: ESB RGB relay behavior
compatible: "zmk,behavior-rgb-esb"

include: [base.yaml]

properties:
  "#binding-cells":
    type: int
    required: true
    const: 2
```

## zmk-kerf/Kconfig
```kconfig
menu "ZMK Kerf Configurator Module"

config ZMK_KERF
	bool "ZMK Kerf Subsystem Support"
	default y
	select SETTINGS
	help
	  Enables Kerf Protocol handling for lighting, battery, power, and profiles.

config ZMK_KERF_MACROS
	bool "Kerf Onboard Macros (&kmacro)"
	default y
	depends on ZMK_KERF
	help
	  Enables 16 slots x 64 steps onboard macro engine.

config ZMK_KERF_USB_HID
	bool "Kerf USB Vendor Raw HID Transport"
	default y
	depends on ZMK_KERF && USB_DEVICE_STACK
	help
	  Exposes 64-byte raw HID report interface on Usage Page 0xFF60.

config ZMK_KERF_BLE_GATT
	bool "Kerf BLE GATT Service Transport"
	default y
	depends on ZMK_KERF && BT
	help
	  Exposes custom GATT service for Kerf Protocol over Bluetooth Low Energy.

endmenu
```

## zmk-kerf/dts/bindings/zmk,behavior-kmacro.yaml
```yaml
description: Runtime configurable onboard macro behavior (&kmacro)
compatible: "zmk,behavior-kmacro"

include: [base.yaml]

properties:
  "#binding-cells":
    type: int
    required: true
    const: 1
```
